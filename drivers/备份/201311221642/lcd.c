/**
    @简介 LCD驱动

    @用法

*/

/********************
2013/11/21 21:52 这是重新来的一种模式，只针对水平向右这种模式
*********************/

#include "stm32f10x.h"
//#include "math.h"
#include "lcd.h"
#include <string.h>
#include <stdio.h>

//#define _ILI_REVERSE_DIRECTION_

//#define LCD_DRIVER_DEBUG

#define LCD_LONG         320
#define LCD_SHORT        240
#define LCD_COLOR_BIT    16

unsigned int LCD_BKCOLOR = 0xffff;
unsigned int LCD_FORCOLOR = 0x0000;

/********* control ***********/

/* LCD is connected to the FSMC_Bank1_NOR/SRAM4 and NE0 is used as ship select signal */
/* RS <==> A2 */
#define LCD_REG              (*((volatile unsigned short *) 0x6C000000)) /* RS = 0 */
#define LCD_RAM              (*((volatile unsigned short *) 0x6C000002)) /* RS = 1 */
#define rw_data_prepare()               write_cmd(34)


/* ----------------------------------------------------------------------------------------------------- */
//private function

void swap(uint *a,uint *b)
{
    uint c;
    c=*a;
    *a=*b;
    *b=c;
}

//简单延时函数
void delay(int cnt)
{
    volatile unsigned int dl;
    while(cnt--)
    {
        for(dl=0; dl<500; dl++);
    }
}

//写命令
static void write_cmd(unsigned short cmd)
{
    LCD_REG = cmd;
}
//读数据
static unsigned short read_data(void)
{
    return LCD_RAM;
}
//写数据
static void write_data(unsigned short data_code )
{
    LCD_RAM = data_code;
}
//写寄存器
static void write_reg(unsigned char reg_addr,unsigned short reg_val)
{
    write_cmd(reg_addr);
    write_data(reg_val);
}
//读寄存器
unsigned short read_reg(unsigned char reg_addr)
{
    unsigned short val=0;
    write_cmd(reg_addr);
    val = read_data();
    return (val);
}

//lcd端口初始化
void lcd_port_init(void)
{
    GPIO_InitTypeDef GPIO_InitStructure;

    /* Enable FSMC, GPIOD, GPIOE, GPIOF, GPIOG and AFIO clocks */
    RCC_AHBPeriphClockCmd(RCC_AHBPeriph_FSMC, ENABLE);

    RCC_APB2PeriphClockCmd(RCC_APB2Periph_GPIOD | RCC_APB2Periph_GPIOE |
                           RCC_APB2Periph_GPIOF | RCC_APB2Periph_GPIOG |
                           RCC_APB2Periph_AFIO, ENABLE);

    /* Set PD.00(D2), PD.01(D3), PD.04(NOE), PD.05(NWE), PD.08(D13), PD.09(D14),
       PD.10(D15), PD.14(D0), PD.15(D1) as alternate
       function push pull */
    GPIO_InitStructure.GPIO_Pin = GPIO_Pin_0 | GPIO_Pin_1 | GPIO_Pin_4 | GPIO_Pin_5 |
                                  GPIO_Pin_8 | GPIO_Pin_9 | GPIO_Pin_10 | GPIO_Pin_14 |
                                  GPIO_Pin_15;
    GPIO_InitStructure.GPIO_Speed = GPIO_Speed_50MHz;
    GPIO_InitStructure.GPIO_Mode = GPIO_Mode_AF_PP;
    GPIO_Init(GPIOD, &GPIO_InitStructure);

    /* Set PE.07(D4), PE.08(D5), PE.09(D6), PE.10(D7), PE.11(D8), PE.12(D9), PE.13(D10),
       PE.14(D11), PE.15(D12) as alternate function push pull */
    GPIO_InitStructure.GPIO_Pin = GPIO_Pin_7 | GPIO_Pin_8 | GPIO_Pin_9 | GPIO_Pin_10 |
                                  GPIO_Pin_11 | GPIO_Pin_12 | GPIO_Pin_13 | GPIO_Pin_14 |
                                  GPIO_Pin_15;
    GPIO_Init(GPIOE, &GPIO_InitStructure);

    /* Set PF.00(A0 (RS)) as alternate function push pull */
    GPIO_InitStructure.GPIO_Pin = GPIO_Pin_0;
    GPIO_Init(GPIOF, &GPIO_InitStructure);

    /* Set PG.12(NE4 (LCD/CS)) as alternate function push pull - CE3(LCD /CS) */
    GPIO_InitStructure.GPIO_Pin = GPIO_Pin_12;
    GPIO_Init(GPIOG, &GPIO_InitStructure);
}

//lcd控制初始化
void lcd_ctl_init(void)
{
    FSMC_NORSRAMInitTypeDef  FSMC_NORSRAMInitStructure;
    FSMC_NORSRAMTimingInitTypeDef  readWriteTiming;
    FSMC_NORSRAMTimingInitTypeDef  writeTiming;

    RCC_AHBPeriphClockCmd(RCC_AHBPeriph_FSMC,ENABLE);	//使能FSMC时钟

    readWriteTiming.FSMC_AddressSetupTime = 0x01;	    //地址建立时间（ADDSET）为2个HCLK 1/36M=27ns
    readWriteTiming.FSMC_AddressHoldTime = 0x00;	    //地址保持时间（ADDHLD）模式A未用到
    readWriteTiming.FSMC_DataSetupTime = 0x0f;		    // 数据保存时间为16个HCLK,因为液晶驱动IC的读数据的时候，速度不能太快，尤其对1289这个IC。
    readWriteTiming.FSMC_BusTurnAroundDuration = 0x00;
    readWriteTiming.FSMC_CLKDivision = 0x00;
    readWriteTiming.FSMC_DataLatency = 0x00;
    readWriteTiming.FSMC_AccessMode = FSMC_AccessMode_A;	 //模式A


    writeTiming.FSMC_AddressSetupTime = 0x01;	 //地址建立时间（ADDSET）为1个HCLK
    writeTiming.FSMC_AddressHoldTime = 0x00;	 //地址保持时间（A
    writeTiming.FSMC_DataSetupTime = 0x03;		 ////数据保存时间为4个HCLK
    writeTiming.FSMC_BusTurnAroundDuration = 0x00;
    writeTiming.FSMC_CLKDivision = 0x00;
    writeTiming.FSMC_DataLatency = 0x00;
    writeTiming.FSMC_AccessMode = FSMC_AccessMode_A;	 //模式A


    FSMC_NORSRAMInitStructure.FSMC_Bank = FSMC_Bank1_NORSRAM4;//  这里我们使用NE4 ，也就对应BTCR[6],[7]。
    FSMC_NORSRAMInitStructure.FSMC_DataAddressMux = FSMC_DataAddressMux_Disable; // 不复用数据地址
    FSMC_NORSRAMInitStructure.FSMC_MemoryType =FSMC_MemoryType_SRAM;// FSMC_MemoryType_SRAM;  //SRAM
    FSMC_NORSRAMInitStructure.FSMC_MemoryDataWidth = FSMC_MemoryDataWidth_16b;//存储器数据宽度为16bit
    FSMC_NORSRAMInitStructure.FSMC_BurstAccessMode =FSMC_BurstAccessMode_Disable;// FSMC_BurstAccessMode_Disable;
    FSMC_NORSRAMInitStructure.FSMC_WaitSignalPolarity = FSMC_WaitSignalPolarity_Low;
    FSMC_NORSRAMInitStructure.FSMC_AsynchronousWait=FSMC_AsynchronousWait_Disable;
    FSMC_NORSRAMInitStructure.FSMC_WrapMode = FSMC_WrapMode_Disable;
    FSMC_NORSRAMInitStructure.FSMC_WaitSignalActive = FSMC_WaitSignalActive_BeforeWaitState;
    FSMC_NORSRAMInitStructure.FSMC_WriteOperation = FSMC_WriteOperation_Enable;	//  存储器写使能
    FSMC_NORSRAMInitStructure.FSMC_WaitSignal = FSMC_WaitSignal_Disable;
    FSMC_NORSRAMInitStructure.FSMC_ExtendedMode = FSMC_ExtendedMode_Enable; // 读写使用不同的时序
    FSMC_NORSRAMInitStructure.FSMC_WriteBurst = FSMC_WriteBurst_Disable;
    FSMC_NORSRAMInitStructure.FSMC_ReadWriteTimingStruct = &readWriteTiming; //读写时序
    FSMC_NORSRAMInitStructure.FSMC_WriteTimingStruct = &writeTiming;  //写时序

    FSMC_NORSRAMInit(&FSMC_NORSRAMInitStructure);  //初始化FSMC配置

    FSMC_NORSRAMCmd(FSMC_Bank1_NORSRAM4, ENABLE);  //

}
//lcd寄存器初始化
void lcd_reg_init(void)
{
    unsigned short deviceid;
    delay(1000);
    deviceid = read_reg(0x00);
  
    if( deviceid==0x9320|| deviceid==0x9300)
    {
        write_reg(0x00,0x0000);
#if defined(_ILI_REVERSE_DIRECTION_)
        write_reg(0x0001,0x0100);                    //Reverse Display
#else
        write_reg(0x0001,0x0000);                    // Driver Output Contral.
#endif
        write_reg(0x02,0x0700);	//LCD Driver Waveform Contral.
//		write_reg(0x03,0x1030);	//Entry Mode Set.
//        write_reg(0x03,0x1018);	//Entry Mode Set.
        write_reg(0x03,0x1028);	//Entry Mode Set.

        write_reg(0x04,0x0000);	//Scalling Contral.
        write_reg(0x08,0x0202);	//Display Contral 2.(0x0207)
        write_reg(0x09,0x0000);	//Display Contral 3.(0x0000)
        write_reg(0x0a,0x0000);	//Frame Cycle Contal.(0x0000)
        write_reg(0x0c,(1<<0));	//Extern Display Interface Contral 1.(0x0000)
        write_reg(0x0d,0x0000);	//Frame Maker Position.
        write_reg(0x0f,0x0000);	//Extern Display Interface Contral 2.

        delay(15);
        write_reg(0x07,0x0101);	//Display Contral.
        delay(15);

        write_reg(0x10,(1<<12)|(0<<8)|(1<<7)|(1<<6)|(0<<4));	//Power Control 1.(0x16b0)
        write_reg(0x11,0x0007);								//Power Control 2.(0x0001)
        write_reg(0x12,(1<<8)|(1<<4)|(0<<0));					//Power Control 3.(0x0138)
        write_reg(0x13,0x0b00);								//Power Control 4.
        write_reg(0x29,0x0000);								//Power Control 7.

        write_reg(0x2b,(1<<14)|(1<<4));

        write_reg(0x50,0);		//Set X Start.
        write_reg(0x51,239);	//Set X End.
        write_reg(0x52,0);		//Set Y Start.
        write_reg(0x53,319);	//Set Y End.

#if defined(_ILI_REVERSE_DIRECTION_)
        write_reg(0x0060,0x2700);  //Driver Output Control.
#else
        write_reg(0x0060,0xA700);
#endif
        write_reg(0x61,0x0001);	//Driver Output Control.
        write_reg(0x6a,0x0000);	//Vertical Srcoll Control.

        write_reg(0x80,0x0000);	//Display Position? Partial Display 1.
        write_reg(0x81,0x0000);	//RAM Address Start? Partial Display 1.
        write_reg(0x82,0x0000);	//RAM Address End-Partial Display 1.
        write_reg(0x83,0x0000);	//Displsy Position? Partial Display 2.
        write_reg(0x84,0x0000);	//RAM Address Start? Partial Display 2.
        write_reg(0x85,0x0000);	//RAM Address End? Partial Display 2.

        write_reg(0x90,(0<<7)|(16<<0));	//Frame Cycle Contral.(0x0013)
        write_reg(0x92,0x0000);	//Panel Interface Contral 2.(0x0000)
        write_reg(0x93,0x0001);	//Panel Interface Contral 3.
        write_reg(0x95,0x0110);	//Frame Cycle Contral.(0x0110)
        write_reg(0x97,(0<<8));	//
        write_reg(0x98,0x0000);	//Frame Cycle Contral.


        write_reg(0x07,0x0173);	//(0x0173)
    }
  
    delay(1000);

}

//设置游标位置
void lcd_set_cursor(unsigned int x,unsigned int y)
{
    if(x>LCD_X_END || y>LCD_Y_END)return;
    write_reg(0x0020,LCD_Y_END-y);
    write_reg(0x0021,x);
}

//设置绘图窗口
void lcd_set_windows(unsigned int x0,unsigned int y0,unsigned int x1,unsigned int y1)
{
    if(x0>x1)swap(&x0,&x1);
    if(y0>y1)swap(&y0,&y1);
    if(x1>LCD_X_END || y1>LCD_Y_END)return;
    write_reg(0x50,LCD_Y_END-y1);		//Set short Start.
    write_reg(0x51,LCD_Y_END-y0);	    //Set short End.
    write_reg(0x52,x0);		//Set long  Start.
    write_reg(0x53,x1);	    //Set long  End.
    lcd_set_cursor(x0,y0);
    rw_data_prepare();
}

//重置绘图窗口
void lcd_reset_windows(void)
{
    lcd_set_windows(0,0,LCD_X_END,LCD_Y_END);
}

/* 读取指定地址的GRAM */
unsigned short lcd_read_gram(unsigned int x,unsigned int y)
{
    unsigned short temp;
    lcd_set_cursor(x,y);
    rw_data_prepare();
    /* dummy read */
    temp = read_data();
    temp = read_data();
    return temp;
}

unsigned short BGR2RGB(unsigned short c)
{
    u16  r, g, b, rgb;
    b = (c>>0)  & 0x1f;
    g = (c>>5)  & 0x3f;
    r = (c>>11) & 0x1f;
    rgb =  (b<<11) + (g<<5) + (r<<0);
    return( rgb );
}

/* ----------------------------------------------------------------------------------------------------- */

//public function

//lcd初始化
void lcd_init(void)
{
    lcd_port_init();
    lcd_ctl_init();
    lcd_reg_init();
}

//获取lcd信息
void lcd_get_info(LCD_INFO *lcd_info)
{
    lcd_info->color_bit = LCD_COLOR_BIT;
    lcd_info->length= LCD_LONG;
    lcd_info->width = LCD_SHORT;
}

//用color画点
void lcd_set_point(unsigned int x,unsigned int y,LCD_COLOR color)
{
    lcd_set_cursor(x,y);
    rw_data_prepare();
    write_data(color);
}

//获取点颜色
LCD_COLOR lcd_get_point(unsigned int x,unsigned int y)
{
    return BGR2RGB( lcd_read_gram(x,y) );
}

//用颜色color清除屏幕
void lcd_clr(LCD_COLOR color)
{
    ulong l;
    l=LCD_LONG*LCD_SHORT;
    lcd_reset_windows();
    //rw_data_prepare();
    while(l--)LCD_RAM =color;
}

//画点
void lcd_draw_point(uint x0,uint y0,LCD_COLOR color)
{
    lcd_reset_windows();
    lcd_set_cursor(x0,y0);
   // rw_data_prepare();
    LCD_RAM = color;
}

//画实心矩形
void lcd_draw_block(unsigned int x0,unsigned y0,unsigned x1,unsigned y1,LCD_COLOR color)
{
    unsigned long l;
    l=(x1-x0+1)*(y1-y0+1);
    lcd_set_windows(x0,y0,x1,y1);
    //rw_data_prepare();
    while(l--)LCD_RAM = color;
    lcd_reset_windows();
}

unsigned char GRAPH_BUF[1600]={0x0,0x1,0xff,0xff,0xff,0xff,0xff,0xff,0xff,0xff,0xff,0xff,0xff,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0xe0,0x0 };
unsigned char *pG=GRAPH_BUF;
//lcd测试
void lcd_test(void)
{
//    unsigned long l;
    unsigned short color;

    int x,y,i,n;
    uchar dat;
    
    lcd_init();
    
    lcd_clr(LCD_COLOR_CYAN);
   // delay(10000);
    
//    color=0;
//    while(1)
//    {
//        lcd_clr(LCD_COLOR_RED);
//        lcd_draw_block(0,0,200,100,LCD_COLOR_GREEN);
//        for(i=0;i<100;i++)lcd_draw_point(i,i,LCD_COLOR_BLUE);
//        while(1);
//    }

    pG = GRAPH_BUF;
   // memset(pG,0xaa,sizeof(GRAPH_BUF));
    
    
    lcd_set_windows(0,40,LCD_X_END,200-1);
    for(y=0;y<80;y++)
    {
        for(n=0;n<2;n++)
        {
            for(x=0;x<20;x++)
            {
                dat=*pG++;
                for(i=0;i<8;i++)
                {   
                    color=(dat&(0x80>>i))?LCD_COLOR_BLACK:LCD_COLOR_WHITE;
                    LCD_RAM=color;
                    LCD_RAM=color;
                }
            }
            if(n==1)pG-=20;
        }
    }
    
    
    
    while(1);
    
}





/* ----------------------------------------------------------------------------------------------------- */
//end of file
